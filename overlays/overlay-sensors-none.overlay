// Sensor overlay: no I2C sensors — disables sht41, scd41, bmp390
// Used by: ND30, ND140, ND143
&sht4x0   { status = "disabled"; };
&scd41_0  { status = "disabled"; };
&bmp390_0 { status = "disabled"; };
