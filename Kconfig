## Kconfig
```kconfig
menu "App options"

config APP_USE_SHT41_SENSOR
    bool "Use SHT41 sensor (I2C temp/humidity)"
    default n

config APP_USE_SCD41_SENSOR
    bool "Use SCD41 sensor (I2C CO2/temp/humidity)"
    default n

config APP_USE_DS18B20_SENSOR
    bool "Use DS18B20 sensor (1-Wire temperature)"
    default n

config APP_USE_MAX31856_SENSOR
	bool "Enable MAX31856 SPI thermocouple sensor(s)"
	default n
	select SPI
	help
	  Reads K-type thermocouple temperature via MAX31856 over SPI (bitbang).
	  Supports up to 4 sensors via aliases max31856-0 .. max31856-3.
	  Publishes NDxx/OUT/MAX31856-N/TEMP, /CJ and /FAULT.

config APP_MAX31856_COUNT
	int "Number of MAX31856 sensors"
	default 2
	range 1 4
	depends on APP_USE_MAX31856_SENSOR
	help
	  Number of MAX31856 thermocouple sensors on the SPI bus.
	  Only sensors 1..N will be initialized and published.

config APP_USE_SEN50_SENSOR
    bool "Use SEN50 sensor (I2C particulate matter)"
    default n

config APP_USE_BMP390_SENSOR
	bool "Enable BMP390 pressure/temperature sensor"
	default n
	help
	  BMP390 via I2C. Gebruikt de Zephyr BMP388 driver
	  (register-compatibel, CONFIG_BMP388=y blijft nodig).
	  Publiceert NDxx/OUT/BMP390-1/PRESSURE en /TEMP.

config APP_USE_WATERMETER_SENSOR
    bool "Use watermeter (GPIO pulse counter via inductive sensor)"
    default n
    select APP_INTERVAL_LOCKED

config APP_INTERVAL_LOCKED
    bool "Lock measurement interval (reject INTERVAL command)"
    default n
    help
      Weiger het INTERVAL commando via NDxx/IN/CMD. Voor nodes waar de
      meetcadans vast moet blijven: pulstellers (watermeter/regenmeter,
      automatisch via select) en vocht-triggernodes zoals badkamer/douche.

config APP_USE_BATT_SENSOR
	bool "Enable battery voltage sensor (ADC P1.14/AIN7, VBAT_EN P1.15)"
	default n
	select ADC
	help
	  Reads LiPo battery voltage via onboard voltage divider (P1.14/AIN7).
	  Enables P1.15 (VBAT_EN) briefly during each measurement.
	  Publishes NDxx/OUT/BATT/MV (millivolt) and NDxx/OUT/BATT/PCT (percent).

config APP_NODE_ID
    string "Node ID (e.g. 12 -> ND12)"
    default "00"

config APP_MEASUREMENT_PERIOD_S
    int "Measurement period (seconds)"
    default 60
    range 1 86400

config APP_BROKER_IPV4
    string "Broker IPv4 address (CoAP-MQTT bridge)"
    default "192.168.1.5"
    help
      IPv4 address of the broker host running the CoAP-MQTT bridge.
      Resolved at runtime to its synthesized IPv6 address using the
      OTBR's NAT64 prefix - so this stays valid across OTBR reboots.

config APP_BROKER_PORT
    int "Broker UDP port"
    default 5684
    range 1 65535

config APP_COAP_ACK_TIMEOUT_MS
    int "CoAP ACK initial timeout (ms)"
    default 800
    range 100 5000

config APP_COAP_RETRIES
    int "CoAP CON retries"
    default 3
    range 0 8

endmenu

source "Kconfig.zephyr"
```
